// Copyright 2021 Manna Harbour
// https://github.com/manna-harbour/miryoku

#define MIRYOKU_KLUDGE_BOTTOMROWCOMBOS
#define MIRYOKU_KLUDGE_THUMBCOMBOS

#include "../miryoku/custom_config.h"
#include "../miryoku/mapping/36/kurp.h"
#include "../miryoku/miryoku.dtsi"
